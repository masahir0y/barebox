## arch/Kconfig
```kconfig
#
# General architecture dependent options
#

config HAVE_UNDERSCORE_SYMBOL_PREFIX
	bool
	help
	  Some architectures generate an _ in front of C symbols; things like
	  module loading and assembly files need to know about this.
```

## arch/arm/configs/uniphier_v7_defconfig
```kconfig
CONFIG_ARCH_UNIPHIER=y
CONFIG_AEABI=y
CONFIG_ARM_UNWIND=y
CONFIG_MMU=y
CONFIG_MALLOC_TLSF=y
CONFIG_KALLSYMS=y
CONFIG_RELOCATABLE=y
CONFIG_HUSH_FANCY_PROMPT=y
CONFIG_CMDLINE_EDITING=y
CONFIG_AUTO_COMPLETE=y
CONFIG_MENU=y
CONFIG_DEFAULT_ENVIRONMENT_GENERIC_NEW=y
CONFIG_DEFAULT_ENVIRONMENT_PATH="arch/arm/mach-uniphier/env"
CONFIG_DEBUG_INFO=y
CONFIG_DEBUG_LL=y
CONFIG_LONGHELP=y
CONFIG_CMD_MEMINFO=y
CONFIG_CMD_BOOTM_SHOW_TYPE=y
CONFIG_CMD_BOOTM_VERBOSE=y
CONFIG_CMD_BOOTM_INITRD=y
CONFIG_CMD_BOOTM_OFTREE=y
CONFIG_CMD_GO=y
CONFIG_CMD_RESET=y
CONFIG_CMD_PARTITION=y
CONFIG_CMD_EXPORT=y
CONFIG_CMD_PRINTENV=y
CONFIG_CMD_SAVEENV=y
CONFIG_CMD_LN=y
CONFIG_CMD_SLEEP=y
CONFIG_CMD_DHCP=y
CONFIG_CMD_EDIT=y
CONFIG_CMD_MENU=y
CONFIG_CMD_MENU_MANAGEMENT=y
CONFIG_CMD_READLINE=y
CONFIG_CMD_TIMEOUT=y
CONFIG_CMD_OFTREE=y
CONFIG_CMD_TIME=y
CONFIG_NET=y
# CONFIG_SPI is not set
CONFIG_FS_TFTP=y
CONFIG_DIGEST=y
CONFIG_MD5=y
```

## arch/arm/mach-uniphier/Kconfig
```kconfig
if ARCH_UNIPHIER

config MACH_PH1_LD4
	bool "PH1-LD4"
	default y
	help
	  PH1-LD4 support

config MACH_PH1_PRO4
	bool "PH1-Pro4"
	default y
	help
	  PH1-Pro4 support

config MACH_PH1_SLD8
	bool "PH1-sLD8"
	default y
	help
	  PH1-sLD8 support

config MACH_PH1_PRO5
	bool "PH1-Pro5"
	default y
	help
	  PH1-sLD8 support

config MACH_PH1_LD6B
	bool "PH1-LD6b"
	default y
	help
	  PH1-LD6b support

config UNIPHIER_NOR_BOOT
	bool "Support NOR Boot"
	default y
	help
	  Support NOR Boot

config UNIPHIER_NAND_BOOT
	bool "Support NAND Boot"
	default y
	help
	  Support NAND Boot

config UNIPHIER_EMMC_BOOT
	bool "Support EMMC Boot"
	default y
	help
	  Support EMMC Boot

config UNIPHIER_USB_BOOT
	bool "Support USB Boot"
	depends on MACH_PH1_SLD8
	default y
	help
	  Support USB Boot

config ARCH_TEXT_BASE
	hex
	default 0x80000000

# The UniPhier ROM code always loads 64KB
config ARCH_BAREBOX_MAX_PBL_SIZE
	hex
	default 0x100000

# FIXME
# We have no interest in the bare_init size,
# but the link fails without the following.
config ARCH_BAREBOX_MAX_BARE_INIT_SIZE
	hex
	default ARCH_BAREBOX_MAX_PBL_SIZE

config DEBUG_UNIPHIER_UART_PORT
	int "Debug UART port"
	depends on DEBUG_LL
	range 0 2
	default 0
	help
	  Debug UART base address.

config DEBUG_UNIPHIER_UART_BAUDRATE
	int "Debug UART baudrate"
	depends on DEBUG_LL
	default 115200
	help
	  Debug UART baudrate.

endif
```
